## conf/machine/mdm9635.conf
```bitbake
#@TYPE: Machine
#@NAME: MDM9635 CDP
#@DESCRIPTION: Machine configuration for Qualcomm MDM9635 CDP

# Uncomment the following line to enable the hard floating point abi. Note that
# this breaks some binary libraries and 3D (neither of which ship with
# meta-yocto). For maximum compatibility, leave this disabled.
#DEFAULTTUNE ?= "cortexa8hf-neon"

include conf/machine/include/tune-cortexa15.inc

MACHINE_DISPLAY_WIDTH_PIXELS = "480"
MACHINE_DISPLAY_HEIGHT_PIXELS = "640"

SERIAL_CONSOLE = "115200 ttyO2"

PREFERRED_PROVIDER_virtual/kernel ?= "linux-quic"

MACHINE_FEATURES += "kernel26"
MACHINE_FEATURES += "keyboard"

MACHINE_DTS_NAME = "mdm9630"

MACHINE_KERNEL_BASE = "0x07100000"
MACHINE_KERNEL_TAGS_OFFSET = "0x07C00000"
PAGE_SIZE= '2048'
GCCVERSION = "4.8%"
```

## conf/machine/mdm9640-perf.conf
```bitbake
#@TYPE: Machine
#@NAME: MDM9640 Perf
#@DESCRIPTION: Machine configuration for QTI MDM9640 for perf.

BASEMACHINE = "mdm9640"

include ${BASEMACHINE}.conf

MACHINEOVERRIDES = "${BASEMACHINE}:${MACHINE}"
```

## conf/machine/mdm9640.conf
```bitbake
#@TYPE: Machine
#@NAME: MDM9640 CDP
#@DESCRIPTION: Machine configuration for QTI MDM9640 CDP


# Uncomment the following line to enable the hard floating point abi. Note that
# this breaks some binary libraries and 3D (neither of which ship with
# meta-yocto). For maximum compatibility, leave this disabled.
#DEFAULTTUNE ?= "cortexa8hf-neon"

include conf/machine/include/tune-cortexa8.inc

MACHINE_DISPLAY_WIDTH_PIXELS = "480"
MACHINE_DISPLAY_HEIGHT_PIXELS = "640"

SERIAL_CONSOLE = "115200 ttyO2"

PREFERRED_PROVIDER_virtual/kernel ?= "linux-quic"

MACHINE_FEATURES += "kernel26"
MACHINE_FEATURES += "keyboard"

MACHINE_DTS_NAME = "msm9640"

#UBINIZE Args
UBINIZE_ARGS = "-m 4096 -p 256KiB -s 4096"
#MKUBIFS Args
MKUBIFS_ARGS = "-m 4096 -e 253952 -c 2146 -F"
#Volume sizes
SYSTEM_VOLUME_SIZE = "38MiB"
CACHE_VOLUME_SIZE = "65MiB"

MACHINE_KERNEL_BASE = "0x81C00000"
MACHINE_KERNEL_TAGS_OFFSET = "0x80E00000"
PAGE_SIZE = '4096'
GCCVERSION = "4.8%"

EXTRA_IMAGECMD_mdm9640 = "-N 2048"
```

## conf/machine/mdmcalifornium-perf.conf
```bitbake
#@TYPE: Machine
#@NAME: MDMCALIFORNIUM Perf
#@DESCRIPTION: Machine configuration for QTI MDMCALIFORNIUM perf.

BASEMACHINE = "mdmcalifornium"

include ${BASEMACHINE}.conf

MACHINEOVERRIDES = "${BASEMACHINE}:${MACHINE}"
```

## conf/machine/mdmcalifornium.conf
```bitbake
#@TYPE: Machine
#@NAME: MDMCALIFORNIUM
#@DESCRIPTION: Machine configuration for QTI MDMCALIFORNIUM MTP

require conf/machine/include/mdmcalifornium.inc

PREFERRED_PROVIDER_virtual/kernel ?= "linux-quic"

KERNEL_IMAGETYPE = "zImage"
MACHINE_DTS_NAME = "mdmcalifornium"
MACHINE_KERNEL_BASE = "0x80000000"
MACHINE_KERNEL_TAGS_OFFSET = "0x82000000"
MACHINE_KERNEL_DEFCONFIG = "mdm${@base_contains('DEFCONF', 'perf',  '-perf', '', d)}_defconfig"
MACHINE_KERNEL_CMD_PARAMS = "noinitrd rw console=ttyHSL0,115200,n8 androidboot.hardware=qcom ehci-hcd.park=3 msm_rtb.filter=0x37 lpm_levels.sleep_disabled=1 earlycon=msm_hsl_uart,0x78b1000"
```

## conf/machine/mdmfermium-perf.conf
```bitbake
#@TYPE: Machine
#@NAME: MDMFERMIUM Perf
#@DESCRIPTION: Machine configuration for QTI MDMFERMIUM for perf.

BASEMACHINE = "mdmfermium"

include ${BASEMACHINE}.conf

MACHINEOVERRIDES = "${BASEMACHINE}:${MACHINE}"
```

## conf/machine/mdmferrum.conf
```bitbake
#@TYPE: Machine
#@NAME: MDMFERRUM CDP
#@DESCRIPTION: Machine configuration for QTI MDMFERRUM CDP


# Uncomment the following line to enable the hard floating point abi. Note that
# this breaks some binary libraries and 3D (neither of which ship with
# meta-yocto). For maximum compatibility, leave this disabled.
#DEFAULTTUNE ?= "cortexa8hf-neon"

include conf/machine/include/tune-cortexa8.inc

MACHINE_DISPLAY_WIDTH_PIXELS = "480"
MACHINE_DISPLAY_HEIGHT_PIXELS = "640"

SERIAL_CONSOLE = "115200 ttyO2"

PREFERRED_PROVIDER_virtual/kernel ?= "linux-quic"

MACHINE_FEATURES += "kernel26"
MACHINE_FEATURES += "keyboard"

MACHINE_DTS_NAME = "msmferrum"

MACHINE_KERNEL_BASE = "0x80000000"
MACHINE_KERNEL_TAGS_OFFSET = "0x01E00000"
```

## conf/machine/mdmzirc-perf.conf
```bitbake
#@TYPE: Machine
#@NAME: MDMZIRC Perf
#@DESCRIPTION: Machine configuration for QTI MDMZIRC for perf.

BASEMACHINE = "mdmzirc"

include ${BASEMACHINE}.conf

MACHINEOVERRIDES = "${BASEMACHINE}:${MACHINE}"
```

## conf/machine/mdmzirc.conf
```bitbake
#@TYPE: Machine
#@NAME: MDMZIRC CDP
#@DESCRIPTION: Machine configuration for QTI MDMZIRC CDP


# Uncomment the following line to enable the hard floating point abi. Note that
# this breaks some binary libraries and 3D (neither of which ship with
# meta-yocto). For maximum compatibility, leave this disabled.
#DEFAULTTUNE ?= "cortexa8hf-neon"

include conf/machine/include/tune-cortexa8.inc

MACHINE_DISPLAY_WIDTH_PIXELS = "480"
MACHINE_DISPLAY_HEIGHT_PIXELS = "640"

SERIAL_CONSOLE = "115200 ttyO2"

PREFERRED_PROVIDER_virtual/kernel ?= "linux-quic"

MACHINE_FEATURES += "kernel26"
MACHINE_FEATURES += "keyboard"

MACHINE_DTS_NAME = "msmzirc"

#UBINIZE Args for all images
UBINIZE_ARGS = "-m 4096 -p 256KiB -s 4096"
#MKUBIFS Args for userdata image
MKUBIFS_USR_ARGS = "-m 4096 -e 253952 -c 2146 -F"

MACHINE_KERNEL_BASE = "0x81400000"
MACHINE_KERNEL_TAGS_OFFSET = "0x80E00000"
PAGE_SIZE = '4096'
GCCVERSION = "4.8%"
```

## conf/machine/msm7627a.conf
```bitbake
#@TYPE: Machine
#@NAME: MSM7627A FFA
#@DESCRIPTION: Machine configuration for Qualcomm MSM7627A FFA

DEFAULTTUNE ?= "cortexa5-neon"

require conf/machine/include/arm/arch-armv7a.inc

TUNEVALID[cortexa5] = "Enable Cortex-A5 specific processor optimizations"
TUNE_CCARGS += "${@bb.utils.contains("TUNE_FEATURES", "cortexa5", "-mtune=cortex-a5", "", d)}"

# Little Endian base configs
AVAILTUNES += "cortexa5 cortexa5t cortexa5-neon"
TUNE_FEATURES_tune-cortexa5 = "${TUNE_FEATURES_tune-armv7a} cortexa5"
TUNE_FEATURES_tune-cortexa5t = "${TUNE_FEATURES_tune-armv7at} cortexa5"
TUNE_FEATURES_tune-cortexa5-neon = "${TUNE_FEATURES_tune-armv7a-neon} cortexa5"
PACKAGE_EXTRA_ARCHS_tune-cortexa5 = "${PACKAGE_EXTRA_ARCHS_tune-armv7at}"
PACKAGE_EXTRA_ARCHS_tune-cortexa5t = "${PACKAGE_EXTRA_ARCHS_tune-armv7at}"
PACKAGE_EXTRA_ARCHS_tune-cortexa5-neon = "${PACKAGE_EXTRA_ARCHS_tune-armv7at-neon}"

# VFP Tunes
AVAILTUNES += "cortexa5hf cortexa5thf cortexa5hf-neon"
TUNE_FEATURES_tune-cortexa5hf ?= "${TUNE_FEATURES_tune-armv7ahf} cortexa5"
TUNE_FEATURES_tune-cortexa5thf ?= "${TUNE_FEATURES_tune-armv7athf} cortexa5"
TUNE_FEATURES_tune-cortexa5hf-neon ?= "${TUNE_FEATURES_tune-armv7ahf-neon} cortexa5"
PACKAGE_EXTRA_ARCHS_tune-cortexa5hf = "${PACKAGE_EXTRA_ARCHS_tune-armv7ahf}"
PACKAGE_EXTRA_ARCHS_tune-cortexa5thf = "${PACKAGE_EXTRA_ARCHS_tune-armv7athf}"
PACKAGE_EXTRA_ARCHS_tune-cortexa5hf-neon = "${PACKAGE_EXTRA_ARCHS_tune-armv7ahf-neon}"

MACHINE_DISPLAY_WIDTH_PIXELS = "480"
MACHINE_DISPLAY_HEIGHT_PIXELS = "640"

KERNEL_DEFCONFIG = "msm7627a-perf_defconfig"

# fastboot image configuration
MACHINE_CONSOLE = "tty0"
MACHINE_ROOTDEV = "/dev/mmcblk0"
MACHINE_KERNEL_BASE = "0x00200000"
MACHINE_FLASH_PAGE_SIZE = "4096"
MACHINE_KERNEL_VERSION = `sed -r 's/#define UTS_RELEASE "(.*)"/\1/' ${STAGING_KERNEL_DIR}/include/generated/utsrelease.h`

PREFERRED_PROVIDER_virtual/kernel ?= "linux-msm"

#TODO: remove
#update-modules needs this
MACHINE_FEATURES += "kernel26"

#Enable X11
DISTRO_FEATURES += "x11"

#Enable rpm packaging
PACKAGE_CLASSES += " package_rpm"

# BB_SIGNATURE_HANDLER The noop value will result in using a '0' for
# the checksum of a shared state binary. The default value is OEBasic.
BB_SIGNATURE_HANDLER = "noop"
```

## conf/machine/msm8226-perf.conf
```bitbake
#@TYPE: Machine
#@NAME: MSM8226 Perf
#@DESCRIPTION: Machine configuration for Qualcomm MSM8226 MTP for perf.

BASEMACHINE = "msm8226"

include ${BASEMACHINE}.conf

MACHINEOVERRIDES = "${BASEMACHINE}:${MACHINE}"

KERNEL_DEFCONFIG = msm8226-perf_defconfig
```

## conf/machine/msm8226.conf
```bitbake
#@TYPE: Machine
#@NAME: MSM8226 MTP
#@DESCRIPTION: Machine configuration for Qualcomm MSM8226 MTP

# Uncomment the following line to enable the hard floating point abi. Note that
# this breaks some binary libraries and 3D (neither of which ship with
# meta-yocto). For maximum compatibility, leave this disabled.
#DEFAULTTUNE ?= "cortexa8hf-neon"

include conf/machine/include/tune-cortexa9.inc

MACHINE_DISPLAY_WIDTH_PIXELS = "480"
MACHINE_DISPLAY_HEIGHT_PIXELS = "800"

SERIAL_CONSOLE = "115200 ttyO2"

PREFERRED_PROVIDER_virtual/kernel ?= "linux-msm"

MACHINE_FEATURES += "kernel26"
MACHINE_FEATURES += "keyboard"

# Provide a config baseline for things so the kernel will build...
KERNEL_DEFCONFIG ?= "msm8226_defconfig"
MACHINE_DTS_NAME = "*8*26"

# fastboot image configuration
MACHINE_CONSOLE = "ttyHSL0"
MACHINE_ROOTDEV = "/dev/mmcblk0p16"
MACHINE_KERNEL_BASE = "0x00000000"
MACHINE_KERNEL_TAGS_OFFSET = "0x01E00000"
MACHINE_FLASH_PAGE_SIZE = "4096"
MACHINE_KERNEL_VERSION = `sed -r 's/#define UTS_RELEASE "(.*)"/\1/' ${STAGING_KERNEL_DIR}/include/generated/utsrelease.h`
BOOTIMAGE_PARTITION_SIZE = 16777216
SYSTEMIMAGE_PARTITION_SIZE = 838860800
USERDATAIMAGE_PARTITION_SIZE = 5066702848

#Enable X11
DISTRO_FEATURES += "x11"

#Device manager
VIRTUAL-RUNTIME_dev_manager = "udev"

#Busybox
PREFERRED_VERSION_busybox = "1.19.3"
PREFERRED_VERSION_busybox-static = "1.19.3"

#Enable rpm packaging
PACKAGE_CLASSES += " package_rpm"
```

## conf/machine/msm8610-perf.conf
```bitbake
#@TYPE: Machine
#@NAME: MSM8610 Perf
#@DESCRIPTION: Machine configuration for Qualcomm MSM8610 MTP for perf.

BASEMACHINE = "msm8610"

include ${BASEMACHINE}.conf

MACHINEOVERRIDES = "${BASEMACHINE}:${MACHINE}"

KERNEL_DEFCONFIG = msm8610-perf_defconfig
```

## conf/machine/msm8610.conf
```bitbake
#@TYPE: Machine
#@NAME: MSM8610 MTP
#@DESCRIPTION: Machine configuration for Qualcomm MSM8610 MTP

require conf/machine/include/arm/arch-armv7a.inc

SDKGCCVERSION="4.5%"
GCCVERSION="4.5%"

MACHINE_DISPLAY_WIDTH_PIXELS = "480"
MACHINE_DISPLAY_HEIGHT_PIXELS = "800"

SERIAL_CONSOLE = "115200 ttyO2"

PREFERRED_PROVIDER_virtual/kernel ?= "linux-msm"

MACHINE_FEATURES += "kernel26"
MACHINE_FEATURES += "keyboard"

# Provide a config baseline for things so the kernel will build...
KERNEL_DEFCONFIG ?= "msm8610_defconfig"
MACHINE_DTS_NAME = "msm8610"

# fastboot image configuration
MACHINE_CONSOLE = "ttyHSL0"
MACHINE_ROOTDEV = "/dev/mmcblk0p12"
MACHINE_KERNEL_BASE = "0x00000000"
MACHINE_KERNEL_TAGS_OFFSET = "0x01E00000"
MACHINE_FLASH_PAGE_SIZE = "4096"
MACHINE_KERNEL_VERSION = `sed -r 's/#define UTS_RELEASE "(.*)"/\1/' ${STAGING_KERNEL_DIR}/include/generated/utsrelease.h`

#Enable X11
DISTRO_FEATURES += "x11"

#Device manager
VIRTUAL-RUNTIME_dev_manager = "udev"

#Busybox
PREFERRED_VERSION_busybox = "1.19.3"
PREFERRED_VERSION_busybox-static = "1.19.3"

#Enable rpm packaging
PACKAGE_CLASSES += " package_rpm"
```

## conf/machine/msm8655.conf
```bitbake
#@TYPE: Machine
#@NAME: MSM8655 FFA
#@DESCRIPTION: Machine configuration for Qualcomm MSM8655 FFA

include conf/machine/include/tune-cortexa8.inc

MACHINE_DISPLAY_WIDTH_PIXELS = "480"
MACHINE_DISPLAY_HEIGHT_PIXELS = "800"

MACHINE_FEATURES += "mm-camera"
MACHINE_FEATURES += "mm-video-oss"

KERNEL_DEFCONFIG = "msm7630-perf_defconfig"


# fastboot image configuration
MACHINE_CONSOLE = "tty0"
MACHINE_ROOTDEV = "/dev/mmcblk0"
MACHINE_KERNEL_BASE = "0x00200000"
MACHINE_FLASH_PAGE_SIZE = "4096"

PREFERRED_PROVIDER_virtual/kernel ?= "linux-msm"

#TODO: remove
#update-modules needs this
MACHINE_FEATURES += "kernel26"

#Enable X11
DISTRO_FEATURES += "x11"

#Enable rpm packaging
PACKAGE_CLASSES += " package_rpm"
```

## conf/machine/msm8909w.conf
```bitbake
#@TYPE: Machine
#@NAME: MSM8909
#@DESCRIPTION: Machine configuration for QTI MSM8909 MTP

require conf/machine/include/msm8909w.inc

KERNEL_IMAGETYPE = "zImage-dtb"
MACHINE_DTS_NAME = "msm8909w"
MACHINE_KERNEL_BASE = "0x81C00000"
MACHINE_KERNEL_TAGS_OFFSET = "0x81900000"
MACHINE_KERNEL_DEFCONFIG = "msm8909w_defconfig"
MACHINE_KERNEL_PERF_DEFCONFIG = "msm8909w-perf_defconfig"
MACHINE_KERNEL_CMD_PARAMS = "noinitrd rw console=ttyHSL0,115200,n8 androidboot.hardware=qcom ehci-hcd.park=3 msm_rtb.filter=0x37 lpm_levels.sleep_disabled=1"
```

## conf/machine/msm8960-perf.conf
```bitbake
#@TYPE: Machine
#@NAME: MSM8960 Perf
#@DESCRIPTION: Machine configuration for Qualcomm MSM8960 MTP for perf.

BASEMACHINE = "msm8960"

include ${BASEMACHINE}.conf

MACHINEOVERRIDES = "${BASEMACHINE}:${MACHINE}"

KERNEL_DEFCONFIG = msm8960-perf_defconfig
```

## conf/machine/msm8960.conf
```bitbake
#@TYPE: Machine
#@NAME: MSM8960 MTP
#@DESCRIPTION: Machine configuration for Qualcomm MSM8960 MTP

# Uncomment the following line to enable the hard floating point abi. Note that
# this breaks some binary libraries and 3D (neither of which ship with
# meta-yocto). For maximum compatibility, leave this disabled.
#DEFAULTTUNE ?= "cortexa8hf-neon"

include conf/machine/include/tune-cortexa8.inc

SDKGCCVERSION="4.5%"
GCCVERSION="4.5%"

MACHINE_DISPLAY_WIDTH_PIXELS = "480"
MACHINE_DISPLAY_HEIGHT_PIXELS = "800"

SERIAL_CONSOLE = "115200 ttyO2"

PREFERRED_PROVIDER_virtual/kernel ?= "linux-msm"

MACHINE_FEATURES += "kernel26"
MACHINE_FEATURES += "keyboard"

# Provide a config baseline for things so the kernel will build...
KERNEL_DEFCONFIG ?= "msm8960_defconfig"
MACHINE_DTS_NAME = "msm8930"

# fastboot image configuration
MACHINE_CONSOLE = "tty0"
MACHINE_ROOTDEV = "/dev/mmcblk0p12"
MACHINE_KERNEL_BASE = "0x80200000"
MACHINE_FLASH_PAGE_SIZE = "4096"
MACHINE_KERNEL_VERSION = `sed -r 's/#define UTS_RELEASE "(.*)"/\1/' ${STAGING_KERNEL_DIR}/include/generated/utsrelease.h`

#Enable X11
DISTRO_FEATURES += "x11"

#Device manager
VIRTUAL-RUNTIME_dev_manager = "udev"

#Busybox
PREFERRED_VERSION_busybox = "1.19.3"
PREFERRED_VERSION_busybox-static = "1.19.3"

#Enable rpm packaging
PACKAGE_CLASSES += " package_rpm"
```

## conf/machine/msm8974-perf.conf
```bitbake
#@TYPE: Machine
#@NAME: MSM8974 Perf
#@DESCRIPTION: Machine configuration for Qualcomm MSM8974 MTP for perf.

BASEMACHINE = "msm8974"

include ${BASEMACHINE}.conf

MACHINEOVERRIDES = "${BASEMACHINE}:${MACHINE}"

KERNEL_DEFCONFIG = msm8974-perf_defconfig
```

## conf/machine/sdxhedgehog-perf.conf
```bitbake
#@TYPE: Machine
#@NAME: SDXHEDGEHOG Perf
#@DESCRIPTION: Machine configuration for QTI SDXHEDGEHOG perf.

BASEMACHINE = "sdxhedgehog"

include ${BASEMACHINE}.conf

MACHINEOVERRIDES = "${BASEMACHINE}:${MACHINE}"
```

## conf/machine/sdxhedgehog.conf
```bitbake
#@TYPE: Machine
#@NAME: SDXHEDGEHOG
#@DESCRIPTION: Machine configuration for QTI SDXHEDGEHOG

require conf/machine/include/sdxhedgehog.inc

PREFERRED_PROVIDER_virtual/kernel ?= "linux-quic"

# Pull in the default security flags
require conf/distro/include/security_flags.inc
# Modify the primary security flag definitions
SECURITY_CFLAGS = "-fstack-protector-strong -pie -fpie -Wa,--noexecstack"
SECURITY_LDFLAGS = "-Wl,-z,relro,-z,now,-z,noexecstack"

KERNEL_IMAGETYPE = "zImage"
KERNEL_DTS_NAME = "sdxhedgehog"
KERNEL_BASE = "0x80000000"
KERNEL_TAGS_OFFSET = "0x82000000"
KERNEL_DEFCONFIG = "sdx_defconfig"
KERNEL_PERF_DEFCONFIG = "sdx-perf_defconfig"
KERNEL_CMD_PARAMS = "noinitrd rw console=ttyHSL0,115200,n8 androidboot.hardware=qcom ehci-hcd.park=3 msm_rtb.filter=0x37 lpm_levels.sleep_disabled=1 earlycon=msm_hsl_uart,0x78b1000"
```
