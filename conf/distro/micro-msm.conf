## conf/distro/micro-msm.conf
```bitbake
#############################################################################
#@TYPE: Distribution
#@NAME: Micro MSM
#@DESCRIPTION: Micro Linux distribution for Qualcomm chipsets
#@MAINTAINER: Linux Build <linux.build@codeaurora.org>
#@COMMENT: This distribution configuration defines a truely tiny OE Linux
#@COMMENT: distribution. The matching buildable image target (micro-msm-image)
#@COMMENT: basically consists of: libc, busybox, udev, sysv init, and a few
#@COMMENT: init scripts for running up the system.
#############################################################################

#############################################################################
# DISTRO CONFIGURATION
#############################################################################
DISTRO_NAME = "micro-msm"
DISTRO_VERSION = "${SRCDATE}"

#############################################################################
# DISTRO FEATURE SELECTION
#############################################################################
# No features selected
DISTRO_FEATURES += "eabi"

#############################################################################
# LIBRARY NAMES
#############################################################################
# Use Debian naming scheme for library (.so) files
INHERIT += "debian"

#############################################################################
# PACKAGING & FEEDS
#############################################################################
# Select packaging system
PREFERRED_PKG_FORMAT = "ipk"
IPKG_VARIANT = "opkg"

require conf/distro/include/sane-feed.inc
require conf/distro/include/sane-feed-${PREFERRED_PKG_FORMAT}.inc

#############################################################################
# IMAGES
#############################################################################
# Name generated images
IMAGE_NAME = "${DISTRO_NAME}-${IMAGE_BASENAME}-${LIBC}-\
${PREFERRED_PKG_FORMAT}-${DISTRO_VERSION}-${MACHINE}"

CACHE ?= "${TMPDIR}/cache/${LIBC}/${MACHINE}"
DEPLOY_DIR ?= "${TMPDIR}/deploy/${LIBC}"
DEPLOY_DIR_IMAGE = "${DEPLOY_DIR}/images/${MACHINE}"
PACKAGE_EXTRA_ARCHS="armv7"

# Image output types
IMAGE_FSTYPES = "tar cpio.gz yaffs2"

# Extend the yaffs2 imaging command string to support setting the proper privs for the file.
IMAGE_CMD_yaffs2 += "; chmod 644 ${DEPLOY_DIR_IMAGE}/${IMAGE_NAME}.rootfs.yaffs2"

#############################################################################
# BOOTLOADER SELECTION
#############################################################################
PREFERRED_PROVIDERS += " virtual/bootloader:lk"

#############################################################################
# LINUX KERNEL SELECTION
#############################################################################
PREFERRED_PROVIDERS += "virtual/kernel:linux"
TARGET_OS = "linux-gnueabi"
KERNEL = "kernel26"
MACHINE_KERNEL_VERSION = "3.0.1"
KERNEL_IMAGETYPE = "Image"

# Kernel staging directories
STAGING_KERNEL_DIR = "${STAGING_DIR_HOST}/usr/src/linux"
STAGING_KERNEL_HEADERS = "${STAGING_KERNEL_DIR}/usr/include"
STAGING_KERNEL_MODULES = "${STAGING_DIR_HOST}/lib/modules"

#############################################################################
# TOOLCHAIN
#############################################################################
LIBC ?= "eglibc"
PREFERRED_VERSION_glibc             ?= "2.10.1"
PREFERRED_VERSION_glibc-initial     ?= "2.10.1"
PREFERRED_ARM_INSTRUCTION_SET ?= "thumb"
require conf/distro/include/sane-toolchain.inc
require conf/distro/include/arm-thumb.inc

#############################################################################
# Ensure MACHINE_CLASS is in OVERRIDES
#############################################################################
MACHINE_CLASS ?= ""
MACHINE_OVERRIDES += "${MACHINE_CLASS}"

#############################################################################
# NLS
#############################################################################
USE_NLS = "no"
USE_NLS_glib-2.0 = "yes"
USE_NLS_glib-2.0-native = "yes"
USE_NLS_gcc-cross = "no"

#############################################################################
# Development Tools
#############################################################################
INHERIT += "devshell"

# Disable binary locale generation
ENABLE_BINARY_LOCALE_GENERATION = "0"

# Don't install useless symlinks to libraries
PACKAGE_SNAP_LIB_SYMLINKS = "1"

# Collapse /usr into /
prefix = ""
exec_prefix = ""
prefix_native = ""

# Don't install ldconfig and associated gubbins
USE_LDCONFIG = "0"

# Disable online package management
ONLINE_PACKAGE_MANAGEMENT = "none"

DISTRO_BLUETOOTH_MANAGER = "bluez4"
```

## conf/distro/msm.conf
```bitbake
#############################################################################
#@TYPE: Distribution
#@NAME: MSM
#@DESCRIPTION: MSM Linux Distribution (glibc based)
#@MAINTAINER: Andrew Walker <andreww@codeaurora.org>
#@COMMENT: This distribution configuration defines a OE Linux
#@COMMENT: distribution. The matching buildable image target (mdm-image)
#@COMMENT: basically consists of: libc, busybox, udev, sysv init, and a few
#@COMMENT: init scripts for running up the system.
#############################################################################

#############################################################################
# DISTRO CONFIGURATION
#############################################################################
DISTRO_NAME = "msm"
DISTRO_VERSION = "${BUILDNAME}"
VIRTUAL-RUNTIME_dev_manager ?= "busybox-mdev"

#############################################################################
# DISTRO FEATURE SELECTION
#############################################################################
MICRO_GOLD = "ld-is-gold"
MICRO_GOLD_mips = ""
MICRO_GOLD_msm8960 = ""
MICRO_GOLD_msm8974 = ""
MICRO_GOLD_msm8610 = ""
MICRO_GOLD_msm8226 = ""

DISTRO_FEATURES += "sysvinit eabi ipv6 ipv4 largefile thumb-interwork xattr ${MICRO_GOLD} ${DISTRO_FEATURES_LIBC}"
USE_DEVFS = "0"

#############################################################################
# LIBRARY NAMES
#############################################################################
# Use Debian naming scheme for library (.so) files
INHERIT += "recipe_sanity"

#############################################################################
# TOOLCHAIN
#############################################################################
PREFERRED_VERSION_autoconf = "2.68"
ARM_INSTRUCTION_SET       ?= "arm"
FULL_OPTIMIZATION          = "-O2 -fexpensive-optimizations -frename-registers -fomit-frame-pointer"

#############################################################################
# NLS
#############################################################################
USE_NLS = "no"
USE_NLS_glib-2.0 = "yes"
USE_NLS_glib-2.0-native = "yes"
USE_NLS_gcc-cross = "no"

# Disable binary locale generation
ENABLE_BINARY_LOCALE_GENERATION = "0"

# Don't install useless symlinks to libraries
PACKAGE_SNAP_LIB_SYMLINKS = "1"

#Allow library symlinks to exist alongside soname files
#for packages that don't create proper symlinks
PACKAGE_SNAP_LIB_SYMLINKS_pn-adreno200 = "0"
PACKAGE_SNAP_LIB_SYMLINKS_pn-geofence = "0"
PACKAGE_SNAP_LIB_SYMLINKS_pn-mm-core-oss = "0"
PACKAGE_SNAP_LIB_SYMLINKS_pn-mm-video-oss = "0"
PACKAGE_SNAP_LIB_SYMLINKS_pn-mm-core-prop = "0"
PACKAGE_SNAP_LIB_SYMLINKS_pn-mm-core-noship = "0"
PACKAGE_SNAP_LIB_SYMLINKS_pn-mm-video-prop = "0"
PACKAGE_SNAP_LIB_SYMLINKS_pn-mm-camera = "0"
PACKAGE_SNAP_LIB_SYMLINKS_pn-mm-camera-lib = "0"
PACKAGE_SNAP_LIB_SYMLINKS_pn-mm-still = "0"
PACKAGE_SNAP_LIB_SYMLINKS_pn-camera-hal = "0"
PACKAGE_SNAP_LIB_SYMLINKS_pn-sudo = "0"
PACKAGE_SNAP_LIB_SYMLINKS_pn-securemsm-noship = "0"
PACKAGE_SNAP_LIB_SYMLINKS_pn-libtbm-msm = "0"
PACKAGE_SNAP_LIB_SYMLINKS_pn-perf-libs = "0"
PACKAGE_SNAP_LIB_SYMLINKS_pn-libdri2 = "0"

# Don't install ldconfig and associated gubbins
USE_LDCONFIG = "0"
LDCONFIGDEPEND = ""
COMMERCIAL_LICENSE_DEPENDEES = ""

# Add the yaffs2 imaging commands to the filesystem support for Bitbake as
# OE-Core doesn't support them directly...
IMAGE_CMD_yaffs2 = "mkyaffs2image ${EXTRA_IMAGECMD} ${IMAGE_ROOTFS} ${DEPLOY_DIR_IMAGE}/${IMAGE_NAME}.rootfs.yaffs2; chmod 644 ${DEPLOY_DIR_IMAGE}/${IMAGE_NAME}.rootfs.yaffs2"

# fastboot imaging commands
IMAGE_DEPENDS_fastboot = "mkbootimg-native virtual/kernel"
IMAGE_CMD_fastboot = "${STAGING_BINDIR_NATIVE}/mkbootimg --kernel ${STAGING_DIR_TARGET}/kernel/arch/arm/boot/Image --ramdisk /dev/null --ramdisk_offset $(awk --non-decimal-data '/ _end/ {end="0x" $1} /_stext/ {beg="0x" $1} END {size1=end-beg+4096; size=and(size1,compl(4095)); printf("%#x",size)}' ${STAGING_DIR_TARGET}/boot/System.map-${MACHINE_KERNEL_VERSION}) --cmdline 'root=${MACHINE_ROOTDEV} rw init=/sbin/init --verbose loglevel=7 rootwait console=${MACHINE_CONSOLE} no_console_suspend=1 androidboot.hardware=qcom log_buf_len=262144' --base ${MACHINE_KERNEL_BASE} ${EXTRA_IMAGECMD} --pagesize ${MACHINE_FLASH_PAGE_SIZE} --output ${DEPLOY_DIR_IMAGE}/${IMAGE_NAME}.rootfs.fastboot"

PREFERRED_VERSION_readline = "5.2"
```

## conf/layer.conf
```bitbake
BBFILES += "${LAYERDIR}/recipes/*/*.bb ${LAYERDIR}/recipes/udev/udev_164.bbappend"
BBPATH .= ":${LAYERDIR}"
BBFILE_COLLECTIONS += "msm"
BBFILE_PRIORITY_msm = "10"
BBFILE_PATTERN_msm := "^${LAYERDIR}/"
```

## conf/machine/9615-cdp.conf
```bitbake
#@TYPE: Machine
#@NAME: MDM9615 CDP
#@DESCRIPTION: Machine configuration for Qualcomm MDM9615 CDP

# Uncomment the following line to enable the hard floating point abi. Note that
# this breaks some binary libraries and 3D (neither of which ship with
# meta-yocto). For maximum compatibility, leave this disabled.
#DEFAULTTUNE ?= "cortexa8hf-neon"

# Set it for the A8 tunings for now which should work for the A5 we've got in the 
# 9615-cdp...
include conf/machine/include/tune-cortexa8.inc

MACHINE_DISPLAY_WIDTH_PIXELS = "480"
MACHINE_DISPLAY_HEIGHT_PIXELS = "640"

SERIAL_CONSOLE = "115200 ttyO2"

PREFERRED_PROVIDER_virtual/kernel ?= "linux-quic"

MACHINE_FEATURES += "kernel26"
MACHINE_FEATURES += "keyboard"
```

## conf/machine/apq8009-perf.conf
```bitbake
#@TYPE: Machine
#@NAME: APQ8009 Perf
#@DESCRIPTION: Machine configuration for QTI APQ8009 for perf.

BASEMACHINE = "apq8009"

include ${BASEMACHINE}.conf

MACHINEOVERRIDES = "${BASEMACHINE}:${MACHINE}"
```

## conf/machine/apq8009.conf
```bitbake
#@TYPE: Machine
#@NAME: APQ8009
#@DESCRIPTION: Machine configuration for QTI APQ8009


# Uncomment the following line to enable the hard floating point abi. Note that
# this breaks some binary libraries and 3D (neither of which ship with
# meta-yocto). For maximum compatibility, leave this disabled.
#DEFAULTTUNE ?= "cortexa8hf-neon"
include conf/machine/include/tune-cortexa7.inc

BBMASK = ".*/*/recipes-kernel/linux-msm-4.4"

MACHINE_DISPLAY_WIDTH_PIXELS = "480"
MACHINE_DISPLAY_HEIGHT_PIXELS = "640"

SERIAL_CONSOLE = "115200 ttyO2"

PREFERRED_PROVIDER_virtual/kernel ?= "linux-quic"

#Enable emmc boot
DISTRO_FEATURES += "emmc-boot"
DISTRO_FEATURES += "persist-image"

MACHINE_FEATURES += "kernel26"
MACHINE_FEATURES += "keyboard"

MACHINE_SOC_NAME = "msm8909"
MACHINE_DTS_NAME = "msm8909"

MACHINE_KERNEL_BASE = "0x81C00000"
MACHINE_KERNEL_TAGS_OFFSET = "0x81900000"
MACHINE_KERNEL_DEFCONFIG = "msm8909${@base_contains('DEFCONF', 'perf',  '-perf', '', d)}_defconfig"
MACHINE_KERNEL_CMD_PARAMS = "noinitrd rw console=ttyHSL0,115200,n8 androidboot.hardware=qcom ehci-hcd.park=3 msm_rtb.filter=0x37 lpm_levels.sleep_disabled=1 rootwait androidboot.bootdevice=7824900.sdhci"

PAGE_SIZE = '4096'

EXTRA_IMAGECMD = "-N 2048"

# Sizes for EXT4 (in bytes)
SYSTEM_SIZE_EXT4 = "1258292000"
USERDATA_SIZE_EXT4 = "2000000000"
CACHE_SIZE_EXT4 = "65536000"

# TEMP FIX: retain existing directory structure for base product.
MACHINE_DEPLOY_NAME = "${@base_contains('PRODUCT', 'base', '${MACHINE}', '${MACHINE}-${PRODUCT}', d)}${@base_contains('DEFCONF', 'perf',  '-perf', '', d)}"

# TODO: Align drone images location on par with other products
DEPLOY_DIR_IMAGE = "${@base_contains('PRODUCT', 'drone',  '${DEPLOY_DIR}/images/${MACHINE}-drone', '${DEPLOY_DIR}/images/${MACHINE_DEPLOY_NAME}', d)}"
```

## conf/machine/apq8017-perf.conf
```bitbake
#@TYPE: Machine
#@NAME: APQ8017 Perf
#@DESCRIPTION: Machine configuration for QTI APQ8017 for perf.

BASEMACHINE = "apq8017"

include ${BASEMACHINE}.conf

MACHINEOVERRIDES = "${BASEMACHINE}:${MACHINE}"
```

## conf/machine/apq8017.conf
```bitbake
#@TYPE: Machine
#@NAME: APQ8017
#@DESCRIPTION: Machine configuration for QTI APQ8017


# Uncomment the following line to enable the hard floating point abi. Note that
# this breaks some binary libraries and 3D (neither of which ship with
# meta-yocto). For maximum compatibility, leave this disabled.
#DEFAULTTUNE ?= "cortexa8hf-neon"

include conf/machine/include/arm/arch-armv8.inc

BBMASK = ".*/*/recipes-kernel/linux-msm-4.4"

MACHINE_DISPLAY_WIDTH_PIXELS = "480"
MACHINE_DISPLAY_HEIGHT_PIXELS = "640"

SERIAL_CONSOLE = "115200 ttyO2"

PREFERRED_PROVIDER_virtual/kernel ?= "linux-quic"

#Enable emmc boot
DISTRO_FEATURES += "emmc-boot"
DISTRO_FEATURES += "persist-image"

MACHINE_FEATURES += "kernel26"
MACHINE_FEATURES += "keyboard"

MACHINE_SOC_NAME = "msm8937"
MACHINE_DTS_NAME = "msm8917"

MACHINE_KERNEL_BASE = "0x81C00000"
MACHINE_KERNEL_TAGS_OFFSET = "0x81900000"
MACHINE_KERNEL_DEFCONFIG = "msm8937${@base_contains('DEFCONF', 'perf',  '-perf', '', d)}_defconfig"
MACHINE_KERNEL_CMD_PARAMS = "noinitrd rw console=ttyHSL0,115200,n8 androidboot.hardware=qcom ehci-hcd.park=3 msm_rtb.filter=0x37 lpm_levels.sleep_disabled=1 root=/dev/mmcblk0p24 rootfstype=ext4 androidboot.bootdevice=7824900.sdhci"

PAGE_SIZE = '4096'

EXTRA_IMAGECMD = "-N 2048"

# Sizes for EXT4 (in bytes)
SYSTEM_SIZE_EXT4 = "134217728"
USERDATA_SIZE_EXT4 = "268435456"
CACHE_SIZE_EXT4 = "65536000"

# TEMP FIX: retain existing directory structure for base product.
MACHINE_DEPLOY_NAME = "${@base_contains('PRODUCT', 'base', '${MACHINE}', '${MACHINE}-${PRODUCT}', d)}${@base_contains('DEFCONF', 'perf',  '-perf', '', d)}"
DEPLOY_DIR_IMAGE = "${DEPLOY_DIR}/images/${MACHINE_DEPLOY_NAME}"

# Multilib configuration
# This sets any packages preprended with lib32- to be built with
# the armv7a tuning (32 bit) instead of 64 bit aarch.
require conf/multilib.conf
MULTILIBS = "multilib:lib32"
DEFAULTTUNE_virtclass-multilib-lib32 = "armv7a"
```

## conf/machine/apq8053-iot-mtp.conf
```bitbake
#@TYPE: Machine
#@NAME: APQ8053-IOT-MTP
#@DESCRIPTION: Machine configuration for QTI IOT MTP with APQ8053

require conf/machine/include/apq8053.inc

PREFERRED_PROVIDER_virtual/kernel ?= "linux-quic"

KERNEL_IMAGETYPE = "Image.gz-dtb"
MACHINE_DTS_NAME = "msm8953"
MACHINE_KERNEL_BASE = "0x80000000"
MACHINE_KERNEL_TAGS_OFFSET = "0x81900000"
MACHINE_KERNEL_DEFCONFIG = "msmcortex${@base_contains('DEFCONF', 'perf',  '-perf', '', d)}_defconfig"
MACHINE_KERNEL_CMD_PARAMS = "noinitrd rw console=ttyHSL0,115200,n8 androidboot.hardware=qcom ehci-hcd.park=3 msm_rtb.filter=0x37 lpm_levels.sleep_disabled=1 root=/dev/mmcblk0p24 rootfstype=ext4 rootwait androidboot.bootdevice=7824900.sdhci"
```

## conf/machine/apq8053-perf.conf
```bitbake
#@TYPE: Machine
#@NAME: APQ8053 Perf
#@DESCRIPTION: Machine configuration for QTI APQ8053 for perf.

BASEMACHINE = "apq8053"

include ${BASEMACHINE}.conf

MACHINEOVERRIDES = "${BASEMACHINE}:${MACHINE}"
```
