## conf/machine/apq8053.conf
```bitbake
#@TYPE: Machine
#@NAME: APQ8053
#@DESCRIPTION: Machine configuration for QTI MTP with APQ8053

require conf/machine/include/apq8053.inc

PREFERRED_PROVIDER_virtual/kernel ?= "linux-quic"

KERNEL_IMAGETYPE = "Image.gz-dtb"
KERNEL_DTS_NAME = "msm8953"
KERNEL_BASE = "0x80000000"
KERNEL_TAGS_OFFSET = "0x81900000"
KERNEL_DEFCONFIG = "msmcortex_defconfig"
KERNEL_PERF_DEFCONFIG = "msmcortex-perf_defconfig"
KERNEL_CMD_PARAMS = "noinitrd rw console=ttyHSL0,115200,n8 androidboot.hardware=qcom ehci-hcd.park=3 msm_rtb.filter=0x37 lpm_levels.sleep_disabled=1 root=/dev/mmcblk0p24 rootfstype=ext4 rootwait androidboot.bootdevice=7824900.sdhci"

DISTRO_FEATURES_append=" selinux"
```

## conf/machine/apq8096.conf
```bitbake
#@TYPE: Machine
#@NAME: APQ8096
#@DESCRIPTION: Machine configuration for QTI MTP with APQ8096

require conf/machine/include/apq8096.inc

PREFERRED_PROVIDER_virtual/kernel ?= "linux-quic"

KERNEL_IMAGETYPE = "Image.gz-dtb"
MACHINE_DTS_NAME = "msm8996"
MACHINE_KERNEL_BASE = "0x80000000"
MACHINE_KERNEL_TAGS_OFFSET = "0x81900000"
MACHINE_KERNEL_DEFCONFIG = "msm_defconfig"
MACHINE_KERNEL_PERF_DEFCONFIG = "msm-perf_defconfig"
MACHINE_KERNEL_CMD_PARAMS = "noinitrd rw console=ttyHSL0,115200,n8 androidboot.hardware=qcom ehci-hcd.park=3 msm_rtb.filter=0x37 lpm_levels.sleep_disabled=1 root=/dev/sde18 rootfstype=ext4"
```

## conf/machine/apq8098.conf
```bitbake
#@TYPE: Machine
#@NAME: APQ8098
#@DESCRIPTION: Machine configuration for QTI MTP with APQ8098

require conf/machine/include/apq8098.inc

PREFERRED_PROVIDER_virtual/kernel ?= "linux-msm-4.4"

KERNEL_IMAGETYPE = "Image.gz-dtb"
MACHINE_DTS_NAME = "msmcobalt"
MACHINE_KERNEL_BASE = "0x80000000"
MACHINE_KERNEL_TAGS_OFFSET = "0x81900000"
MACHINE_KERNEL_DEFCONFIG = "msmcortex_defconfig"
MACHINE_KERNEL_PERF_DEFCONFIG = "msmcortex-perf_defconfig"
MACHINE_KERNEL_CMD_PARAMS = "noinitrd rw rootwait console=ttyMSM0,115200,n8 no_console_suspend=1 earlycon=msm_serial_dm,0xc1b0000 androidboot.hardware=qcom androidboot.console=ttyMSM0 service_locator.enable=1 sched_enable_hmp=1 sched_enable_power_aware=1 ehci-hcd.park=3 msm_rtb.filter=0x37 lpm_levels.sleep_disabled=1 root=/dev/sde20 rootfstype=ext4 earlyprintk"
```

## conf/machine/include/basemachine.inc
```bitbake
BASEMACHINE ??= ""

# Add BASEMACHINE to machine overrides
MACHINEOVERRIDES =. "${@['', '${BASEMACHINE}:']['${BASEMACHINE}' != '']}"

# Define BASEMACHINE_ARCH
BASEMACHINE_ARCH =  "${@['${MACHINE_ARCH}', '${BASEMACHINE}']['${BASEMACHINE}' != '']}"
```

## conf/machine/include/bluechip.inc
```bitbake
# use this for overrides
MACHINE_CLASS = "bluechip"

# CPU
BASE_PACKAGE_ARCH = "armv7"
FEED_ARCH = "armv7"
TARGET_ARCH = "arm"
TARGET_CC_ARCH = "-march=armv7-a -mfpu=neon -mfloat-abi=softfp"
```

## conf/machine/include/msm-cortex-a5.inc
```bitbake
# Additions and overrides to the 'bluechip' ARCH definitions for A5-based
require bluechip.inc
SOC_FAMILY = "msm-cortex-a5"
```

## conf/machine/include/msm-krait.inc
```bitbake
# Additions and overrides to the 'bluechip' ARCH definitions for krait-based
# processors.
require bluechip.inc
SOC_FAMILY = "msm-krait"
```

## conf/machine/include/msm-scorpion.inc
```bitbake
# Additions and overrides to the 'bluechip' ARCH definitions for scorpion-based
# processors.
require bluechip.inc
SOC_FAMILY = "msm-scorpion"
```

## conf/machine/include/msm8909w.inc
```bitbake
BASEMACHINE ?= "apq8009"
require conf/machine/include/basemachine.inc

# Uncomment the following line to enable the hard floating point abi. Note that
# this breaks some binary libraries and 3D (neither of which ship with
# meta-yocto). For maximum compatibility, leave this disabled.
#DEFAULTTUNE ?= "cortexa8hf-neon"

require conf/machine/include/apq8009.inc

MACHINE_DISPLAY_WIDTH_PIXELS ?= "320"
MACHINE_DISPLAY_HEIGHT_PIXELS ?= "320"

MACHINE_SOC_NAME ?= "msm8909w"

EXTRA_IMAGECMD ?= "-N 2048"

# Sizes for EXT4 (in bytes)
SYSTEM_SIZE_EXT4 ?= "536870912"
USERDATA_SIZE_EXT4 ?= "200000000"
CACHE_SIZE_EXT4 ?= "65536000"
```

## conf/machine/include/sdxhedgehog.inc
```bitbake
BASEMACHINE ?= "sdxhedgehog"
require conf/machine/include/basemachine.inc

SOC_FAMILY ?= "mdm9x50"
include conf/machine/include/soc-family.inc

# Uncomment the following line to enable the hard floating point abi. Note that
# this breaks some binary libraries and 3D (neither of which ship with
# meta-yocto). For maximum compatibility, leave this disabled.
#DEFAULTTUNE ?= "cortexa8hf-neon"

include conf/machine/include/tune-cortexa8.inc

BBMASK = ".*/*/recipes-kernel/linux-msm-4.4"

MACHINE_DISPLAY_WIDTH_PIXELS ?= "480"
MACHINE_DISPLAY_HEIGHT_PIXELS ?= "640"

SERIAL_CONSOLE ?= "115200 ttyHSL0"

DISTRO ?= "mdm"

MACHINE_FEATURES += "kernel26 keyboard"

PAGE_SIZE ?= '2048'

# Max supported inodes
EXTRA_IMAGECMD ?= "-N 2048"

#UBINIZE Args
UBINIZE_ARGS ?= "-m 2048 -p 128KiB -s 2048"
#MKUBIFS Args
MKUBIFS_ARGS ?= "-m 2048 -e 126976 -c 1073 -F"
#Volume sizes
SYSTEM_VOLUME_SIZE ?= "90MiB"
CACHE_VOLUME_SIZE ?= "5MiB"

# Sizes for EXT4 (in bytes)
SYSTEM_SIZE_EXT4 ?= "90000000"
USERDATA_SIZE_EXT4 ?= "2000000000"
CACHE_SIZE_EXT4 ?= "80000000"
```

## conf/machine/mdm9607-perf.conf
```bitbake
#@TYPE: Machine
#@NAME: MDM9607 Perf
#@DESCRIPTION: Machine configuration for QTI MDM9607 for perf.

BASEMACHINE = "mdm9607"

include ${BASEMACHINE}.conf

MACHINEOVERRIDES = "${BASEMACHINE}:${MACHINE}"
```

## conf/machine/mdm9607.conf
```bitbake
#@TYPE: Machine
#@NAME: MDM9607 CDP
#@DESCRIPTION: Machine configuration for QTI MDM9607 CDP

require conf/machine/include/mdm9607.inc

PREFERRED_PROVIDER_virtual/kernel ?= "linux-quic"

KERNEL_IMAGETYPE = "zImage"
MACHINE_DTS_NAME = "mdm9607"
MACHINE_KERNEL_BASE = "0x80000000"
MACHINE_KERNEL_TAGS_OFFSET = "0x81E00000"
MACHINE_KERNEL_DEFCONFIG = "mdm9607_defconfig"
MACHINE_KERNEL_PERF_DEFCONFIG = "mdm9607-perf_defconfig"
MACHINE_KERNEL_CMD_PARAMS = "noinitrd ro console=ttyHSL0,115200,n8 androidboot.hardware=qcom ehci-hcd.park=3 msm_rtb.filter=0x37 lpm_levels.sleep_disabled=1 earlycon=msm_hsl_uart,0x78b3000"
```

## conf/machine/mdm9625-perf.conf
```bitbake
#@TYPE: Machine
#@NAME: MDM9625 Perf
#@DESCRIPTION: Machine configuration for Qualcomm MDM9625 CDP for perf.

BASEMACHINE = "mdm9625"

include ${BASEMACHINE}.conf

MACHINEOVERRIDES = "${BASEMACHINE}:${MACHINE}"
```

## conf/machine/mdm9625.conf
```bitbake
#@TYPE: Machine
#@NAME: MDM9625 CDP
#@DESCRIPTION: Machine configuration for Qualcomm MDM9625 CDP

# Uncomment the following line to enable the hard floating point abi. Note that
# this breaks some binary libraries and 3D (neither of which ship with
# meta-yocto). For maximum compatibility, leave this disabled.
#DEFAULTTUNE ?= "cortexa8hf-neon"

include conf/machine/include/tune-cortexa8.inc

MACHINE_DISPLAY_WIDTH_PIXELS = "480"
MACHINE_DISPLAY_HEIGHT_PIXELS = "640"

SERIAL_CONSOLE = "115200 ttyO2"

PREFERRED_PROVIDER_virtual/kernel ?= "linux-quic"

MACHINE_FEATURES += "kernel26"
MACHINE_FEATURES += "keyboard"

# Provide a config baseline for things so the kernel will build...
KERNEL_DEFCONFIG = "msm9625_defconfig"
MACHINE_DTS_NAME = "msm9625"
```

## conf/machine/mdm9635-perf.conf
```bitbake
#@TYPE: Machine
#@NAME: MDM9635 Perf
#@DESCRIPTION: Machine configuration for Qualcomm MDM9635 CDP for perf.

BASEMACHINE = "mdm9635"

include ${BASEMACHINE}.conf

MACHINEOVERRIDES = "${BASEMACHINE}:${MACHINE}"
```
